## sdkconfig.defaults.esp32p4
```kconfig
CONFIG_IDF_TARGET="esp32p4"
CONFIG_ZB_ENABLED=y
# CONFIG_ZB_SDK_1xx is not set
CONFIG_ZB_ZCZR=y
# CONFIG_ZB_RADIO_NATIVE is not set
CONFIG_ZB_RADIO_SPINEL_UART=y
CONFIG_OPENTHREAD_SPINEL_ONLY=y
CONFIG_SPIRAM=y
CONFIG_SPIRAM_MODE_OCT=y
```
